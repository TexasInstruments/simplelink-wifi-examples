/**
 * Import the modules used in this configuration.
 */
const FreeRTOS              = scripting.addModule("/freertos/FreeRTOS");
const CryptoKeyKeyStore_PSA = scripting.addModule("/ti/drivers/CryptoKeyKeyStore_PSA");
const GPIO                  = scripting.addModule("/ti/drivers/GPIO");
const GPIO1                 = GPIO.addInstance();
const Power                 = scripting.addModule("/ti/drivers/Power");
const UART2                 = scripting.addModule("/ti/drivers/UART2");
const UART21                = UART2.addInstance();
const LED                   = scripting.addModule("/ti/drivers/apps/LED", {}, false);
const LED1                  = LED.addInstance();
const Settings              = scripting.addModule("/ti/posix/freertos/Settings");
// @cliArgs --board /ti/boards/LP_EM_CC35X1 --rtos freertos

/**
 * Write custom configuration values to the imported modules.
 */
FreeRTOS.useTimeSlicing = true;

/* Heap size set to 0x00050000 for TLS + OTA buffers */
FreeRTOS.heapSize       = 0x00050000;

GPIO1.$hardware = system.deviceData.board.components.LED_RED;
GPIO1.$name     = "CONFIG_GPIO_LED_0";

UART21.$name                     = "CONFIG_UART2_0";
UART21.$hardware                 = system.deviceData.board.components.XDS110UART;
UART21.uart.dmaTxChannel.$assign = "DMA_CH2";
UART21.uart.dmaRxChannel.$assign = "DMA_CH3";

LED1.$hardware = system.deviceData.board.components.LED_GREEN;
LED1.$name     = "CONFIG_LED_GREEN";

/**
 * Pinmux solution for unlocked pins/peripherals. This ensures that minor changes to the automatic solver in a future
 * version of the tool will not impact the pinmux you originally saw.  These lines can be completely deleted in order to
 * re-solve from scratch.
 */
GPIO1.gpioPin.$suggestSolution            = "boosterpack.31";
UART21.uart.$suggestSolution              = "UART1";
UART21.uart.txPin.$suggestSolution        = "GPIO5";
UART21.uart.rxPin.$suggestSolution        = "GPIO6";
LED1.ledPin.$suggestSolution              = "boosterpack.17";
